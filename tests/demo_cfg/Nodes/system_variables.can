/*@!Encoding:1252*/

variables
{
  msTimer t_1s;
}

on start
{
  setTimerCyclic(t_1s, 100);
}

on timer t_1s
{
  if(@sys_var_demo::speed == 360)
  {
    @sys_var_demo::speed = 0;
  }
  else
  {
    @sys_var_demo::speed += 1;
  }
}


int addition_function(long var1, long var2)
{
  long return_value;
  return_value = var1 + var2;
  write("addition_function triggered. received argument values (%d, %d). calculated return value = %d", var1, var2, return_value);
  return var1 + var2;
}

void hello_world(void)
{
  write("hello_world function triggered. this is only a test function to say hello world !");
}
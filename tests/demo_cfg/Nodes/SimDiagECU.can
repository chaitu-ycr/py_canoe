/*@!Encoding:1252*/
// --------------------------------------------------
// Simple diagnostics ECU simulation.
// For the sake of simplicity, this example omits 
// security access mechanisms, especially for the
// write services. In many cases, return parameters
// are not checked at all.
// Only a subset of services will be answered with
// a positive response, for the rest a negative
// response "Subfunction not supported" will be
// returned.
//
// CANoe 10.0 and higher
// --------------------------------------------------

includes
{
  // From CANoe 10.0, neither including the CAPL callback interface nor adding
  // the corresponding transport protocol node layer DLL is necessary, because 
  // the "built-in" diagnostic channel of CANoe can be used.  
}

variables
{
  // Global initial Parameter values for ECU simulation ("internal ECU memory")
  int gVehicleSpeedToLockDoor=15; // vehicle speed for locking the doors in km/h
  byte gEcuIdentification[13]={0x01,0x02,0x03,0x04,0x05,0x06,0x07,0x08,0x09,0x0A,0x0B,0x0C,0x0D};
  byte gLocalResponse[4092]={0x11, 78, 245, 143, 31, 148, 235, 18, 19, 246, 194, 158, 216, 208, 206, 253, 48, 205, 254, 72, 128, 161, 151, 152, 195, 2, 42, 86, 45, 175, 104, 74, 109, 247, 216, 148, 1, 108, 110, 40, 69, 190, 192, 6, 43, 163, 162, 142, 172, 187, 101, 3, 118, 163, 90, 121, 121, 35, 137, 53, 174, 79, 242, 205, 167, 68, 182, 251, 19, 103, 239, 60, 138, 128, 151, 182, 191, 69, 132, 205, 108, 17, 18, 168, 111, 121, 222, 241, 88, 223, 213, 123, 95, 144, 54, 215, 240, 221, 87, 133, 219, 195, 35, 35, 70, 81, 19, 92, 112, 66, 87, 222, 245, 221, 214, 185, 81, 195, 242, 117, 121, 213, 80, 13, 201, 46, 148, 190, 56, 86, 24, 5, 57, 251, 243, 151, 216, 20, 229, 227, 85, 86, 168, 87, 190, 189, 113, 183, 138, 78, 247, 225, 90, 48, 189, 50, 172, 95, 248, 13, 125, 208, 47, 7, 51, 187, 251, 69, 206, 241, 101, 184, 0, 240, 203, 116, 190, 114, 119, 82, 236, 216, 196, 227, 126, 178, 19, 125, 108, 107, 22, 196, 228, 75, 239, 224, 72, 226, 252, 100, 86, 162, 239, 96, 43, 81, 203, 97, 73, 36, 194, 17, 107, 52, 111, 187, 90, 4, 2, 133, 15, 194, 134, 147, 110, 49, 34, 63, 63, 78, 149, 47, 98, 5, 182, 48, 243, 175, 173, 225, 88, 208, 128, 61, 230, 51, 177, 83, 192, 133, 0, 61, 189, 149, 107, 35, 67, 56, 204, 72, 89, 115, 90, 94, 74, 188, 195, 248, 183, 87, 171, 127, 131, 82, 20, 192, 225, 159, 162, 14, 110, 205, 217, 28, 135, 220, 106, 43, 199, 70, 158, 130, 126, 136, 181, 200, 92, 95, 115, 69, 99, 182, 119, 82, 198, 83, 170, 112, 96, 171, 29, 162, 162, 47, 194, 208, 245, 220, 252, 87, 6, 37, 188, 187, 173, 133, 151, 63, 224, 86, 44, 171, 194, 131, 42, 195, 207, 205, 222, 154, 209, 210, 7, 157, 229, 155, 192, 235, 35, 185, 61, 235, 109, 111, 80, 254, 130, 111, 193, 225, 244, 79, 213, 203, 55, 49, 32, 187, 124, 207, 186, 251, 206, 126, 182, 192, 188, 21, 91, 30, 158, 138, 0, 207, 248, 78, 244, 188, 28, 44, 137, 225, 232, 61, 186, 248, 32, 154, 146, 142, 61, 204, 223, 101, 237, 174, 174, 56, 16, 185, 109, 241, 102, 141, 190, 72, 38, 60, 244, 136, 149, 20, 124, 213, 52, 252, 84, 125, 113, 127, 39, 140, 249, 45, 142, 192, 23, 72, 80, 104, 105, 221, 140, 19, 155, 146, 210, 116, 148, 48, 175, 177, 183, 183, 35, 20, 225, 44, 36, 178, 143, 138, 40, 84, 25, 158, 190, 100, 146, 34, 195, 24, 170, 239, 27, 238, 200, 59, 7, 48, 29, 86, 68, 41, 182, 158, 237, 147, 34, 98, 144, 30, 14, 111, 137, 212, 42, 20, 117, 161, 68, 254, 234, 158, 161, 229, 245, 169, 124, 56, 153, 211, 124, 139, 3, 96, 89, 221, 189, 238, 182, 36, 125, 22, 102, 58, 7, 41, 166, 78, 88, 203, 86, 125, 155, 10, 42, 105, 80, 189, 2, 72, 194, 81, 2, 231, 131, 59, 10, 81, 187, 60, 38, 222, 241, 22, 108, 58, 236, 116, 159, 139, 24, 64, 194, 157, 240, 67, 94, 61, 231, 157, 19, 158, 84, 243, 226, 218, 228, 9, 82, 174, 153, 234, 66, 189, 30, 187, 28, 245, 77, 76, 11, 106, 58, 135, 150, 180, 19, 95, 51, 219, 183, 126, 58, 136, 187, 3, 14, 74, 21, 243, 100, 67, 97, 241, 4, 88, 68, 86, 34, 59, 78, 56, 83, 50, 129, 80, 32, 158, 156, 44, 102, 46, 92, 41, 241, 159, 4, 1, 23, 73, 242, 184, 222, 146, 238, 5, 53, 231, 157, 175, 62, 11, 125, 244, 145, 38, 182, 94, 131, 21, 151, 4, 158, 16, 121, 190, 161, 20, 182, 235, 223, 184, 225, 92, 156, 14, 176, 30, 45, 156, 10, 138, 228, 60, 150, 108, 46, 78, 81, 151, 78, 162, 184, 118, 96, 129, 251, 253, 113, 227, 203, 115, 245, 11, 119, 216, 81, 194, 177, 49, 61, 53, 222, 119, 128, 46, 82, 145, 120, 182, 170, 228, 65, 195, 4, 37, 54, 172, 51, 77, 222, 102, 146, 88, 17, 162, 254, 185, 140, 234, 9, 252, 253, 75, 115, 186, 212, 152, 11, 14, 93, 177, 250, 32, 40, 204, 198, 98, 184, 62, 110, 212, 28, 152, 95, 215, 194, 249, 151, 105, 41, 191, 141, 40, 177, 49, 37, 254, 84, 28, 38, 245, 201, 247, 83, 242, 130, 174, 124, 97, 104, 0, 234, 112, 88, 122, 234, 136, 96, 230, 196, 237, 156, 161, 187, 41, 45, 134, 82, 226, 41, 183, 126, 249, 121, 52, 118, 244, 4, 163, 232, 152, 62, 65, 140, 154, 173, 146, 28, 250, 167, 242, 230, 174, 176, 233, 197, 76, 254, 98, 124, 52, 109, 138, 152, 89, 159, 172, 166, 126, 248, 7, 157, 131, 197, 161, 60, 85, 131, 147, 151, 168, 3, 239, 21, 29, 183, 209, 133, 210, 92, 146, 246, 114, 62, 78, 62, 145, 203, 5, 175, 10, 218, 166, 36, 96, 185, 245, 227, 98, 6, 29, 42, 159, 137, 59, 139, 253, 13, 15, 200, 163, 60, 230, 229, 232, 79, 111, 24, 155, 254, 228, 233, 241, 210, 218, 192, 46, 188, 232, 23, 66, 229, 178, 59, 233, 119, 20, 217, 30, 59, 218, 63, 181, 126, 233, 48, 211, 9, 73, 42, 42, 36, 46, 107, 251, 128, 58, 234, 136, 214, 108, 242, 212, 84, 208, 111, 20, 28, 23, 2, 38, 182, 104, 106, 17, 103, 113, 50, 18, 12, 182, 208, 196, 29, 174, 183, 139, 52, 43, 42, 185, 124, 107, 173, 172, 187, 81, 71, 1, 11, 35, 210, 60, 5, 55, 6, 54, 97, 39, 45, 227, 35, 15, 59, 102, 26, 121, 44, 154, 135, 179, 97, 158, 49, 221, 31, 252, 195, 90, 97, 168, 60, 57, 126, 24, 126, 127, 102, 57, 99, 100, 128, 197, 227, 75, 229, 148, 119, 2, 223, 46, 238, 102, 228, 154, 28, 126, 99, 62, 73, 229, 138, 161, 98, 70, 0, 129, 41, 6, 85, 232, 24, 12, 223, 111, 90, 149, 199, 222, 207, 205, 32, 53, 247, 175, 166, 202, 19, 129, 236, 31, 183, 163, 190, 5, 114, 25, 61, 119, 220, 26, 229, 77, 219, 245, 24, 178, 182, 29, 55, 158, 124, 38, 132, 94, 55, 86, 72, 96, 136, 59, 57, 250, 8, 146, 136, 142, 181, 238, 167, 46, 182, 46, 61, 123, 0, 81, 78, 195, 206, 0, 162, 29, 37, 29, 36, 247, 69, 89, 84, 135, 227, 6, 243, 85, 145, 206, 0, 146, 36, 33, 23, 124, 33, 136, 231, 255, 170, 249, 3, 210, 185, 109, 224, 151, 179, 140, 118, 143, 73, 31, 65, 226, 74, 72, 176, 146, 144, 146, 17, 221, 77, 10, 116, 215, 148, 248, 55, 116, 246, 25, 242, 41, 97, 146, 149, 179, 66, 111, 112, 167, 103, 168, 247, 252, 78, 219, 72, 96, 94, 82, 135, 118, 77, 16, 133, 154, 225, 232, 199, 89, 69, 106, 86, 86, 66, 77, 20, 79, 20, 105, 1, 236, 236, 249, 95, 127, 229, 46, 192, 110, 208, 45, 60, 109, 131, 51, 122, 8, 255, 220, 146, 73, 76, 44, 186, 91, 155, 142, 28, 99, 149, 0, 34, 206, 66, 148, 29, 67, 48, 120, 39, 195, 166, 163, 166, 251, 225, 123, 225, 125, 200, 220, 122, 115, 212, 75, 251, 99, 166, 140, 88, 126, 123, 146, 102, 245, 173, 207, 2, 220, 69, 192, 193, 200, 1, 197, 193, 93, 43, 136, 19, 183, 113, 169, 242, 164, 80, 95, 67, 52, 70, 243, 3, 131, 160, 38, 6, 249, 229, 239, 208, 96, 77, 226, 145, 185, 64, 123, 230, 214, 193, 250, 167, 87, 132, 107, 124, 65, 91, 87, 81, 58, 145, 200, 174, 42, 184, 232, 118, 167, 169, 245, 10, 240, 192, 70, 156, 117, 244, 167, 14, 81, 145, 164, 135, 107, 165, 71, 208, 246, 74, 19, 72, 248, 9, 228, 116, 198, 171, 222, 38, 247, 45, 9, 208, 116, 90, 216, 192, 93, 58, 211, 246, 185, 98, 152, 156, 195, 7, 111, 118, 242, 1, 17, 190, 31, 241, 132, 246, 35, 23, 142, 42, 139, 69, 231, 30, 251, 196, 60, 210, 92, 101, 164, 68, 122, 189, 142, 202, 109, 94, 219, 3, 217, 185, 250, 72, 150, 31, 193, 196, 99, 154, 155, 123, 80, 122, 25, 0, 239, 191, 137, 108, 244, 216, 249, 70, 94, 116, 56, 59, 182, 171, 99, 56, 148, 120, 248, 98, 6, 242, 227, 136, 206, 195, 176, 210, 98, 29, 169, 190, 91, 131, 26, 236, 238, 100, 163, 44, 187, 188, 222, 151, 96, 208, 227, 0, 124, 135, 130, 92, 213, 9, 76, 180, 49, 25, 248, 32, 73, 61, 245, 136, 66, 77, 26, 182, 252, 50, 124, 30, 245, 97, 40, 92, 52, 126, 109, 97, 3, 65, 97, 160, 89, 93, 255, 53, 202, 162, 180, 146, 44, 174, 112, 157, 145, 42, 231, 95, 149, 143, 242, 185, 2, 239, 18, 17, 255, 60, 12, 186, 57, 227, 13, 51, 52, 161, 75, 236, 73, 53, 75, 28, 189, 131, 147, 243, 59, 165, 182, 193, 243, 164, 73, 6, 52, 75, 115, 43, 11, 118, 172, 250, 50, 22, 151, 88, 14, 109, 242, 27, 21, 132, 34, 44, 6, 36, 221, 207, 85, 161, 63, 128, 250, 199, 192, 23, 86, 0, 19, 144, 0, 56, 244, 203, 121, 58, 28, 207, 15, 24, 97, 245, 80, 79, 169, 134, 148, 142, 203, 20, 130, 184, 253, 253, 43, 115, 211, 224, 100, 128, 203, 222, 150, 89, 177, 162, 5, 82, 184, 104, 49, 14, 23, 241, 56, 41, 179, 124, 168, 176, 186, 37, 66, 30, 244, 8, 164, 31, 139, 36, 93, 46, 220, 85, 159, 168, 85, 181, 36, 33, 100, 142, 251, 65, 249, 10, 92, 94, 10, 12, 197, 159, 135, 77, 200, 220, 167, 154, 137, 193, 19, 194, 152, 50, 76, 65, 214, 155, 205, 146, 44, 34, 192, 236, 157, 151, 129, 150, 45, 199, 49, 226, 38, 41, 213, 167, 66, 63, 217, 151, 141, 210, 69, 229, 167, 110, 172, 112, 57, 213, 155, 114, 72, 22, 130, 200, 179, 177, 171, 243, 29, 58, 160, 87, 208, 146, 29, 220, 59, 2, 127, 54, 179, 125, 227, 254, 90, 143, 142, 190, 75, 194, 62, 166, 95, 132, 239, 17, 83, 196, 105, 181, 127, 101, 246, 230, 184, 234, 235, 173, 217, 25, 223, 50, 56, 186, 94, 71, 139, 128, 187, 175, 134, 205, 140, 249, 182, 59, 204, 84, 73, 209, 167, 96, 100, 115, 165, 225, 215, 231, 174, 115, 103, 155, 109, 72, 125, 236, 239, 72, 145, 232, 120, 96, 6, 239, 8, 116, 225, 156, 253, 50, 155, 230, 139, 17, 194, 32, 100, 127, 0, 219, 224, 126, 165, 207, 51, 157, 84, 249, 103, 116, 184, 137, 96, 232, 125, 222, 76, 97, 205, 125, 144, 149, 248, 246, 213, 153, 189, 210, 1, 81, 251, 95, 177, 145, 223, 139, 77, 101, 167, 24, 250, 32, 78, 124, 110, 233, 152, 238, 37, 100, 45, 17, 217, 246, 99, 37, 94, 155, 91, 0, 214, 165, 79, 229, 2, 246, 217, 205, 121, 184, 54, 72, 84, 123, 55, 58, 218, 95, 4, 242, 187, 181, 245, 136, 38, 229, 146, 155, 179, 151, 172, 156, 50, 113, 181, 151, 65, 109, 191, 73, 1, 57, 242, 232, 179, 2, 227, 204, 28, 94, 25, 11, 54, 13, 87, 133, 10, 123, 45, 252, 173, 73, 171, 192, 56, 131, 57, 229, 74, 222, 198, 131, 191, 162, 57, 21, 29, 83, 42, 162, 228, 241, 76, 206, 60, 212, 109, 50, 192, 221, 230, 62, 10, 213, 218, 178, 213, 254, 234, 123, 61, 146, 84, 31, 224, 251, 219, 101, 228, 81, 94, 166, 162, 16, 100, 102, 16, 205, 79, 45, 227, 0, 135, 0, 249, 59, 5, 0, 54, 103, 169, 57, 119, 123, 67, 159, 145, 17, 29, 41, 195, 0, 12, 26, 215, 198, 162, 138, 7, 8, 43, 41, 236, 206, 242, 99, 194, 156, 80, 215, 65, 254, 202, 226, 137, 176, 89, 216, 118, 166, 8, 86, 82, 213, 147, 214, 137, 205, 83, 22, 191, 78, 186, 97, 157, 25, 183, 117, 215, 18, 203, 122, 30, 134, 223, 254, 147, 101, 103, 17, 235, 16, 229, 0, 82, 182, 86, 190, 68, 122, 242, 37, 174, 242, 212, 106, 249, 157, 80, 52, 82, 17, 55, 59, 197, 220, 36, 240, 14, 159, 162, 133, 238, 84, 197, 157, 174, 246, 158, 210, 181, 111, 79, 87, 126, 225, 244, 172, 48, 188, 174, 194, 57, 150, 8, 229, 0, 118, 140, 80, 245, 42, 138, 246, 61, 68, 56, 23, 2, 186, 125, 192, 10, 140, 29, 3, 168, 82, 55, 134, 155, 8, 192, 45, 248, 40, 119, 107, 178, 151, 91, 228, 137, 250, 116, 235, 150, 218, 219, 179, 38, 50, 182, 56, 60, 36, 190, 7, 158, 233, 200, 87, 137, 211, 119, 248, 205, 146, 202, 39, 242, 208, 19, 119, 63, 92, 41, 101, 19, 121, 24, 102, 178, 106, 36, 112, 127, 99, 57, 4, 66, 108, 210, 145, 203, 2, 73, 205, 154, 55, 19, 154, 29, 148, 222, 40, 75, 203, 225, 46, 161, 208, 22, 251, 122, 226, 138, 1, 59, 24, 63, 141, 171, 72, 169, 25, 254, 240, 4, 157, 217, 247, 249, 32, 150, 57, 83, 86, 107, 94, 138, 205, 213, 213, 23, 47, 113, 204, 173, 85, 27, 83, 133, 122, 2, 195, 234, 53, 30, 160, 41, 5, 109, 80, 8, 22, 225, 59, 156, 241, 148, 103, 254, 89, 134, 164, 118, 247, 174, 192, 215, 79, 17, 4, 197, 48, 3, 77, 93, 141, 124, 245, 3, 132, 13, 123, 185, 117, 72, 30, 226, 16, 19, 196, 165, 231, 122, 77, 124, 179, 90, 199, 130, 160, 116, 53, 141, 141, 210, 59, 116, 18, 180, 253, 246, 120, 21, 28, 49, 144, 213, 207, 181, 129, 77, 70, 104, 217, 106, 225, 46, 232, 234, 181, 67, 194, 227, 39, 40, 211, 0, 104, 91, 15, 144, 92, 201, 172, 175, 30, 146, 242, 64, 127, 232, 80, 69, 190, 34, 2, 134, 81, 250, 194, 167, 221, 35, 170, 203, 54, 6, 110, 119, 110, 90, 10, 169, 227, 71, 219, 149, 233, 78, 170, 98, 111, 200, 134, 87, 137, 207, 77, 120, 28, 67, 45, 181, 223, 101, 53, 120, 228, 23, 118, 227, 217, 25, 147, 4, 116, 169, 37, 65, 164, 4, 247, 155, 60, 177, 7, 195, 223, 185, 80, 229, 249, 137, 136, 218, 129, 121, 248, 249, 254, 5, 163, 231, 3, 217, 23, 163, 77, 83, 21, 232, 24, 8, 31, 221, 234, 115, 60, 133, 92, 119, 247, 47, 233, 213, 159, 9, 208, 113, 142, 17, 53, 158, 104, 184, 35, 127, 59, 209, 245, 3, 220, 114, 205, 102, 252, 44, 190, 80, 46, 56, 126, 119, 32, 218, 238, 81, 25, 36, 141, 135, 88, 218, 61, 130, 168, 65, 94, 176, 71, 153, 108, 231, 255, 81, 133, 71, 44, 100, 228, 105, 104, 62, 137, 205, 177, 9, 106, 225, 62, 103, 46, 30, 177, 11, 195, 224, 134, 48, 137, 125, 167, 211, 250, 83, 131, 52, 53, 97, 133, 172, 69, 177, 98, 22, 195, 239, 210, 9, 214, 118, 46, 101, 230, 42, 68, 50, 236, 240, 9, 207, 130, 18, 144, 35, 245, 156, 54, 52, 221, 247, 139, 61, 182, 87, 22, 106, 151, 46, 233, 48, 13, 65, 204, 14, 25, 109, 248, 249, 19, 232, 102, 31, 61, 244, 161, 110, 188, 44, 236, 231, 75, 70, 110, 50, 128, 77, 190, 219, 222, 64, 19, 94, 248, 226, 68, 78, 163, 215, 180, 253, 53, 121, 19, 230, 145, 45, 217, 202, 108, 147, 236, 246, 225, 32, 222, 88, 32, 38, 67, 246, 254, 15, 54, 125, 246, 77, 55, 217, 101, 185, 154, 5, 49, 73, 188, 217, 81, 243, 64, 48, 189, 129, 53, 114, 99, 168, 227, 173, 28, 66, 110, 134, 9, 236, 100, 130, 118, 178, 161, 10, 8, 138, 18, 163, 186, 191, 187, 204, 18, 48, 179, 245, 35, 22, 177, 47, 118, 84, 133, 213, 100, 25, 117, 80, 181, 189, 238, 249, 198, 125, 194, 3, 190, 205, 104, 164, 121, 117, 254, 224, 106, 249, 189, 141, 174, 23, 123, 114, 60, 186, 243, 181, 156, 109, 239, 60, 224, 100, 209, 231, 1, 251, 255, 124, 128, 208, 90, 66, 202, 63, 192, 36, 235, 146, 61, 139, 34, 136, 104, 173, 102, 241, 198, 36, 210, 159, 56, 116, 220, 131, 129, 123, 2, 179, 255, 188, 180, 131, 241, 121, 113, 22, 234, 65, 87, 22, 63, 215, 229, 255, 98, 22, 24, 176, 123, 13, 218, 59, 115, 197, 234, 55, 159, 184, 205, 95, 151, 194, 108, 98, 149, 211, 67, 129, 179, 13, 185, 94, 117, 139, 172, 183, 108, 192, 203, 91, 6, 243, 103, 134, 103, 217, 143, 23, 241, 161, 66, 30, 30, 59, 152, 247, 254, 216, 226, 47, 130, 162, 233, 195, 46, 83, 87, 246, 231, 136, 88, 238, 63, 233, 60, 210, 5, 60, 209, 29, 121, 94, 193, 100, 37, 25, 137, 78, 72, 66, 121, 127, 216, 162, 239, 44, 118, 10, 113, 15, 164, 45, 169, 192, 122, 176, 185, 195, 126, 149, 47, 93, 57, 235, 245, 32, 0, 131, 179, 86, 133, 165, 155, 169, 150, 247, 24, 93, 52, 152, 250, 127, 38, 130, 5, 63, 211, 148, 139, 56, 39, 181, 128, 252, 143, 94, 218, 92, 44, 182, 73, 24, 146, 192, 203, 46, 235, 229, 159, 229, 179, 150, 25, 103, 234, 114, 25, 241, 254, 162, 234, 118, 32, 0, 87, 26, 246, 8, 103, 94, 113, 185, 208, 11, 148, 76, 223, 178, 136, 136, 251, 225, 238, 129, 209, 255, 145, 134, 219, 104, 241, 109, 101, 211, 148, 42, 76, 91, 0, 233, 211, 196, 189, 36, 38, 175, 47, 122, 101, 239, 92, 43, 215, 193, 151, 116, 148, 158, 36, 89, 8, 27, 4, 15, 51, 234, 208, 25, 176, 242, 105, 100, 168, 116, 210, 215, 67, 108, 236, 232, 78, 11, 229, 188, 30, 235, 112, 248, 191, 204, 235, 246, 94, 28, 48, 196, 57, 128, 202, 111, 8, 26, 39, 106, 107, 172, 90, 84, 73, 193, 117, 173, 43, 240, 60, 135, 86, 228, 245, 39, 15, 233, 111, 115, 184, 103, 234, 146, 240, 179, 54, 112, 70, 249, 17, 95, 187, 54, 160, 130, 143, 100, 131, 90, 1, 31, 176, 45, 105, 4, 230, 114, 14, 33, 175, 38, 141, 87, 99, 47, 67, 121, 152, 190, 70, 81, 114, 212, 154, 174, 193, 81, 201, 49, 99, 148, 194, 133, 182, 172, 240, 135, 68, 91, 167, 228, 183, 109, 28, 247, 78, 252, 241, 150, 103, 94, 35, 82, 234, 63, 72, 187, 10, 178, 51, 208, 193, 148, 182, 12, 108, 142, 202, 24, 62, 143, 102, 31, 156, 58, 90, 185, 252, 177, 176, 138, 136, 39, 239, 165, 188, 204, 29, 132, 148, 143, 19, 124, 248, 116, 149, 81, 227, 194, 72, 148, 141, 207, 72, 114, 20, 189, 118, 59, 126, 73, 215, 70, 26, 74, 26, 110, 22, 234, 151, 187, 32, 235, 3, 126, 48, 38, 28, 156, 52, 242, 89, 68, 48, 32, 19, 252, 109, 60, 186, 250, 16, 186, 38, 102, 93, 97, 127, 65, 157, 25, 154, 30, 242, 44, 189, 9, 107, 176, 237, 107, 8, 176, 119, 95, 144, 233, 139, 200, 182, 27, 24, 21, 79, 36, 85, 113, 204, 29, 203, 38, 62, 171, 43, 135, 98, 65, 26, 12, 93, 189, 131, 160, 3, 14, 216, 28, 219, 53, 160, 201, 66, 73, 231, 103, 141, 102, 22, 219, 246, 216, 42, 148, 197, 183, 53, 48, 143, 150, 75, 16, 208, 65, 120, 132, 204, 131, 69, 242, 151, 76, 72, 93, 132, 22, 76, 213, 171, 91, 46, 149, 155, 96, 254, 113, 70, 158, 39, 56, 149, 145, 237, 154, 240, 21, 167, 156, 223, 249, 54, 249, 19, 99, 107, 72, 40, 45, 66, 237, 144, 57, 116, 97, 82, 79, 148, 3, 53, 16, 194, 125, 13, 129, 82, 231, 195, 43, 153, 155, 215, 138, 129, 62, 94, 28, 108, 33, 178, 165, 65, 37, 73, 218, 187, 247, 253, 237, 251, 111, 200, 241, 27, 172, 140, 80, 174, 210, 71, 18, 103, 138, 162, 25, 77, 194, 120, 238, 168, 34, 251, 53, 25, 18, 27, 133, 218, 200, 218, 22, 59, 94, 21, 213, 225, 140, 211, 114, 117, 56, 201, 77, 98, 219, 153, 81, 188, 137, 234, 236, 59, 34, 164, 95, 31, 227, 57, 167, 204, 206, 40, 20, 237, 16, 84, 113, 95, 64, 46, 177, 112, 196, 91, 211, 74, 229, 12, 137, 113, 29, 91, 38, 144, 73, 96, 25, 130, 103, 21, 214, 172, 229, 93, 238, 64, 151, 133, 139, 208, 241, 201, 46, 78, 116, 83, 47, 229, 245, 154, 187, 173, 83, 161, 148, 122, 180, 157, 16, 29, 8, 9, 224, 11, 237, 69, 221, 61, 46, 205, 209, 178, 212, 14, 212, 62, 8, 218, 238, 235, 14, 46, 91, 57, 158, 247, 173, 159, 38, 83, 28, 83, 247, 172, 2, 19, 23, 34, 45, 34, 220, 117, 96, 192, 119, 91, 177, 160, 230, 179, 193, 222, 207, 26, 219, 154, 18, 7, 152, 13, 121, 68, 24, 42, 21, 141, 212, 199, 141, 63, 26, 23, 25, 160, 153, 156, 79, 122, 214, 129, 116, 145, 231, 150, 240, 72, 73, 3, 117, 246, 252, 34, 80, 176, 82, 58, 148, 121, 219, 8, 206, 32, 45, 147, 62, 181, 114, 3, 203, 6, 44, 91, 201, 76, 86, 32, 97, 140, 216, 228, 201, 232, 27, 149, 188, 198, 34, 200, 50, 109, 65, 253, 9, 192, 62, 72, 52, 205, 254, 93, 76, 100, 205, 236, 65, 153, 141, 87, 126, 93, 200, 61, 179, 110, 150, 153, 102, 121, 109, 23, 163, 24, 107, 105, 216, 52, 101, 155, 85, 127, 72, 223, 251, 239, 42, 160, 134, 82, 233, 48, 97, 140, 141, 104, 126, 57, 209, 36, 127, 108, 89, 213, 114, 217, 116, 168, 137, 44, 77, 163, 207, 234, 187, 220, 48, 229, 224, 45, 8, 179, 206, 46, 207, 147, 30, 61, 233, 241, 226, 106, 9, 165, 87, 23, 203, 238, 9, 68, 7, 64, 219, 130, 109, 167, 45, 154, 241, 250, 73, 248, 22, 6, 196, 234, 97, 214, 80, 143, 62, 76, 77, 20, 74, 35, 21, 143, 139, 205, 171, 187, 63, 234, 229, 49, 140, 238, 5, 155, 58, 255, 131, 70, 242, 181, 135, 66, 253, 249, 222, 196, 138, 192, 235, 171, 6, 23, 64, 71, 122, 230, 110, 174, 14, 83, 63, 252, 48, 143, 89, 238, 99, 63, 106, 108, 155, 190, 180, 97, 60, 152, 66, 117, 164, 93, 135, 110, 64, 252, 222, 219, 174, 60, 81, 208, 20, 17, 36, 229, 35, 47, 180, 103, 26, 1, 5, 60, 193, 0, 130, 120, 40, 74, 42, 156, 193, 168, 131, 80, 41, 26, 18, 125, 165, 92, 214, 172, 120, 154, 159, 123, 23, 8, 70, 175, 250, 107, 133, 147, 225, 232, 71, 75, 178, 251, 178, 46, 168, 202, 85, 42, 235, 8, 210, 149, 240, 120, 6, 239, 240, 214, 63, 29, 121, 172, 120, 148, 26, 13, 215, 210, 91, 214, 236, 247, 69, 205, 225, 27, 220, 218, 244, 231, 180, 126, 210, 105, 226, 10, 27, 137, 116, 111, 161, 103, 242, 56, 212, 9, 181, 52, 60, 148, 92, 143, 132, 148, 8, 255, 226, 25, 178, 75, 200, 59, 72, 115, 60, 117, 221, 21, 103, 106, 147, 155, 180, 99, 133, 177, 0x10, 0x11, 0x12};
  int gVehicleType=2; // Sedan
  
  // Access modes for reading and writing diagnostic parameters
  const cAccessModeNumerical=0;
  const cAccessModePhysical=1;
  const cAccessModeCoded=2;
}

on diagRequest Door.Variant_Coding_Write
{
  diagResponse this resp; // response corresponding to the service handled by this "on diagRequest" handler (Variant_Coding_Write)
  int newSpeed;
  int newVehicleType;
  
  // read parameter (default=physical) and store it for later use
  newVehicleType=(int)this.GetParameter("Codingstring.VehicleType"); 
  
  // "this" refers to the LockConfiguration_Write request
  newSpeed=(int)this.GetParameter(cAccessModePhysical, "Codingstring.VehicleSpeedToLockDoor"); 
  
  if(newSpeed>250 || newSpeed <0 || gVehicleType<=0 || gVehicleType>3) {
    // Negative Response Code (NRC): Request out of Range (as example)
    // Equivalent syntax: DiagSendNegativeResponse(resp,0x31);
    resp.SendNegativeResponse(0x31); 
  }    
  else
  {
    // Save the speed and car type into internal ECU memory for next read access
    gVehicleSpeedToLockDoor=newSpeed; 
    gVehicleType=newVehicleType;
    
    // send positive response, value has been written
    resp.SendPositiveResponse(); 
  }
}

on diagrequest Door.EcuIdentification_Write
{
  diagResponse this resp;
  
  // read parameter in raw format as it is 13 bytes long
  this.GetParameterRaw("Part_Number",gEcuIdentification,elcount(gEcuIdentification)); 
  
  // send positive response, value has been written
  resp.SendPositiveResponse(); 
}

on diagRequest Door.Variant_Coding_Read
{
  diagResponse this resp;    

  // set parameter for response (numerical format)
  resp.SetParameter("Codingstring.VehicleType",gVehicleType); 
  
  // set other parameter for response (physical format)
  resp.SetParameter(cAccessModePhysical, "VehicleSpeedToLockDoor",gVehicleSpeedToLockDoor);   
  
  // send positive response, values have been set in response
  resp.SendPositiveResponse();   
}

on diagRequest Door.EcuIdentification_Read
{
  diagResponse this resp;
  
  // set parameter in raw format (size = 13 bytes) for response
  resp.SetParameterRaw("Part_Number",gEcuIdentification,elcount(gEcuIdentification)); 
  
  // send positive response, value has been set in response
  resp.SendPositiveResponse();   
}

on diagRequest Door.SeedLevel_0x01_Request
{
  // Respond with a negative response using a dedicated negative response code (just for demonstration purposes).
  // NRC 0x22 = "Conditions not correct or request sequence error"
  this.SendNegativeResponse(0x22); 
}

on diagRequest Door.DummyBDD.ReadLongPayload
{
  diagResponse this resp;
  resp.SetParameterRaw("Data", gLocalResponse, elCount(gLocalResponse));
  resp.SendPositiveResponse();
}

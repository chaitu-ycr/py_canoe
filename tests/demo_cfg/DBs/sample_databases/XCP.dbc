VERSION "HIPBNYYYYYYYYYYYYYYYYYYYYYYYYYYYNNNYNNNNNN/4/%%%/4/'%**4NNN///"

NS_ :

BS_:

BU_:

BO_ 2 XCPResponse: 8 Vector__XXX
 SG_ PID : 0|8@1+ (1,0) [0|0] "" Vector__XXX

BO_ 1 XCPRequest: 8 Vector__XXX
 SG_ PID : 0|8@1+ (1,0) [0|0] "" Vector__XXX

CM_ "CAN communication matrix for body electronics
*******************************************************

implemented: turn lights, warning lights, windows


";
VAL_ 2 PID 255 "Response" 254 "Error" 253 "Event" 252 "Serv" ;
VAL_ 1 PID 255 "Connect" 254 "Disconnect" 253 "Get_Status" 252 "Synch" 251 "Get_Comm_Mode_Info" 250 "Get_Id" 249 "Set_Request" 248 "Get_Seed" 247 "Unlock" 246 "Set_Mta" 245 "Upload" 244 "Short_Upload" 243 "Build_Checksum" 242 "Transport_Layer_Cmd" 241 "User_Cmd" 240 "Download" 239 "Download_Next" 238 "Download_Max" 237 "Short_Download" 236 "Modify_Bits" ;

AUTOSAR XML (schema 4-0-3)
standard types defined: boolean, sint16
package /VehicleProject
  system System
package /NM
  nm config NmConfig
package /TP
  can tp config CAN00_CAN: communication-cluster=Easy
    can tp channel TPCH: channel-id=0, channel-mode=FULL-DUPLEX-MODE
package /Cluster
  can cluster Easy: protocol-name=CAN  # easy
    can physical channel CHNL: comm-connectors=[Display/CN_CAN00, Engine/CN_CAN00, Light/CN_CAN00]
      frame EngineState_Frame: id 0x123, from Engine, to Display, frame-length=2, can-addressing-mode=STANDARD
        pdu EngineState: length=2, minimum-delay=0.001, transmission-mode-false-timing=cyclic-timing={time-offset=0, time-period=0.1}, transmission-mode-true-timing=cyclic-timing={time-offset=0, time-period=0.1}, unused-bit-pattern=0
          signal OnOff: start 0, 1 bit, little-endian, init-value=0, base-type=boolean, compu {0=Cx0_Off, 1=Cx1_On, phys=raw for raw 0..1}, transfer-property=PENDING, to Display
          signal EngineSpeed: start 1, 15 bit, little-endian, init-value=0, base-type=sint16, compu {phys=raw for raw -16384..16383; unit rpm}, unit=rpm, transfer-property=PENDING, to Display
      frame LightState_Frame: id 0x321, from Light, to Display, frame-length=1, can-addressing-mode=STANDARD
        pdu LightState: length=1, minimum-delay=0.001, transmission-mode-false-timing={cyclic-timing={time-offset=0, time-period=0.1}, event-controlled-timing={number-of-repetitions=0, repetition-period=0}}, transmission-mode-true-timing={cyclic-timing={time-offset=0, time-period=0.1}, event-controlled-timing={number-of-repetitions=0, repetition-period=0}}, unused-bit-pattern=0
          signal HeadLight: start 0, 1 bit, little-endian, init-value=0, base-type=boolean, compu {phys=raw for raw 0..1}, transfer-property=TRIGGERED-ON-CHANGE-WITHOUT-REPETITION, to Display
          signal FlashLight: start 2, 1 bit, little-endian, init-value=0, base-type=boolean, compu {phys=raw for raw 0..1}, transfer-property=PENDING, to Display
package /ECU
  ecu instance Display: associated-com-i-pdu-group=Display_oCAN00_Rx
    can communication controller CT_CAN00
    can communication connector CN_CAN00: comm-controller=Display/CT_CAN00
  ecu instance Engine: associated-com-i-pdu-group=Engine_oCAN00_Tx
    can communication controller CT_CAN00
    can communication connector CN_CAN00: comm-controller=Engine/CT_CAN00
  ecu instance Light: associated-com-i-pdu-group=Light_oCAN00_Tx
    can communication controller CT_CAN00
    can communication connector CN_CAN00: comm-controller=Light/CT_CAN00
package /IPDUGroup
  i signal i pdu group Display_oCAN00_Rx: communication-direction=IN, i-signal-i-pdus=[EngineState, LightState]
  i signal i pdu group Engine_oCAN00_Tx: communication-direction=OUT, i-signal-i-pdus=EngineState
  i signal i pdu group Light_oCAN00_Tx: communication-direction=OUT, i-signal-i-pdus=LightState
package /DataType/Unit
  unit U_rpm: display-name=rpm
